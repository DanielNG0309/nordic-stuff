## cs_ras_multi/projects/initator_build/Kconfig
```kconfig
mainmenu "Channel sounding Application"

config CS_BUILD_INITIATOR
  bool "Build the project as an initiator for CS"
  default n
  help
    Correctly assigns libraries to build initiator

config CS_BUILD_REFLECTOR
  bool "Build the project as a reflector for CS"
  default n
  help
    Correctly assigns libraries to build reflector

config CS_CALC
  bool "Enable sample solution for calculating the distance during Channel Sounding"
  default n
  help
    Selecting this assigns the sample method to calculate Channel Sounding
  select FPU
  select FPU_SHARING
  select BT_CS_DE

config THREAD_CHECK
  bool "Enable thread-analyzer and extra stack instrumentation"
  default n
  help
    Activates Zephyr's built-in thread analyzer, which automatically
    reports stack sizes and thread names during runtime
  select THREAD_ANALYZER
  select THREAD_ANALYZER_AUTO
  select INIT_STACKS
  select THREAD_NAME

config TAG_PRINT
  bool "Enable RTT print for tag"
  default n 
  help
     Enables RTT for logging  
  select USE_SEGGER_RTT 
  select LOG
  select LOG_BACKEND_RTT
  select LOG_PROCESS_THREAD
  select RTT_CONSOLE

config DK_PRINT 
  bool "Enable UART print for dk"
  default n 
  help
     Enables UART for logging
  select SERIAL 
  select UART_CONSOLE

source "Kconfig.zephyr"
```

## flpr_sleep_test/testcase.yaml
```yaml
common:
  sysbuild: true
  tags:
    - ci_build
    - ci_tests_benchmarks_multicore
  platform_allow:
    - nrf54h20dk/nrf54h20/cpuapp
    - nrf54lm20dk/nrf54lm20a/cpuapp
    - nrf54l15dk/nrf54l15/cpuapp
  integration_platforms:
    - nrf54h20dk/nrf54h20/cpuapp
    - nrf54lm20dk/nrf54lm20a/cpuapp
    - nrf54l15dk/nrf54l15/cpuapp

tests:

  # -------------------------------------------------------------------------
  # nRF54H20 tests
  # -------------------------------------------------------------------------

  benchmarks.multicore.flpr_sleep_test.h20_no_sleep:
    platform_allow:
      - nrf54h20dk/nrf54h20/cpuapp
    integration_platforms:
      - nrf54h20dk/nrf54h20/cpuapp
    required_snippets:
      - nordic-log-stm
    harness: console
    harness_config:
      type: multi_line
      ordered: true
      regex:
        - "app/flpr_sleep_test: Multicore flpr_sleep_test on"
        - "flpr/flpr_sleep_test: Multicore flpr_sleep_test on"
        - "flpr_sleep_test: Run 0"
        - "flpr_sleep_test: Run 1"

  benchmarks.multicore.flpr_sleep_test.h20_idle_retained:
    platform_allow:
      - nrf54h20dk/nrf54h20/cpuapp
    tags: ppk_power_measure
    extra_args:
      - flpr_sleep_test_CONF_FILE=prj_silent.conf
      - remote_flpr_CONF_FILE=prj_silent.conf
      - flpr_sleep_test_CONFIG_TEST_SLEEP_DURATION_MS=500
      - remote_flpr_CONFIG_TEST_SLEEP_DURATION_MS=500
      - flpr_sleep_test_EXTRA_DTC_OVERLAY_FILE="${ZEPHYR_NRF_MODULE_DIR}/tests/benchmarks/multicore/common/workaround_idle_retained.overlay"
    harness: pytest
    harness_config:
      fixture: ppk_power_measure
      pytest_root:
        - "${CUSTOM_ROOT_TEST_DIR}/test_measure_power_consumption.py::test_measure_and_data_dump_ppr_and_idle"

  benchmarks.multicore.flpr_sleep_test.h20_idle:
    platform_allow:
      - nrf54h20dk/nrf54h20/cpuapp
    tags: ppk_power_measure
    extra_args:
      - flpr_sleep_test_CONF_FILE=prj_silent.conf
      - remote_flpr_CONF_FILE=prj_silent.conf
      - flpr_sleep_test_CONFIG_TEST_SLEEP_DURATION_MS=500
      - remote_flpr_CONFIG_TEST_SLEEP_DURATION_MS=500
      - flpr_sleep_test_EXTRA_DTC_OVERLAY_FILE="${ZEPHYR_NRF_MODULE_DIR}/tests/benchmarks/multicore/common/workaround_idle.overlay"
    harness: pytest
    harness_config:
      fixture: ppk_power_measure
      pytest_root:
        - "${CUSTOM_ROOT_TEST_DIR}/test_measure_power_consumption.py::test_measure_and_data_dump_ppr_and_idle"

  benchmarks.multicore.flpr_sleep_test.h20_s2ram:
    platform_allow:
      - nrf54h20dk/nrf54h20/cpuapp
    tags: ppk_power_measure
    extra_args:
      - flpr_sleep_test_CONF_FILE=prj_silent.conf
      - remote_flpr_CONF_FILE=prj_silent.conf
    harness: pytest
    harness_config:
      fixture: ppk_power_measure
      pytest_root:
        - "${CUSTOM_ROOT_TEST_DIR}/test_measure_power_consumption.py::test_measure_and_data_dump_ppr_and_s2ram"

  # -------------------------------------------------------------------------
  # nRF54LM20A tests
  # -------------------------------------------------------------------------

  benchmarks.multicore.flpr_sleep_test.lm20_no_sleep:
    platform_allow:
      - nrf54lm20dk/nrf54lm20a/cpuapp
    integration_platforms:
      - nrf54lm20dk/nrf54lm20a/cpuapp
    harness: console
    harness_config:
      type: multi_line
      ordered: true
      regex:
        - "flpr_sleep_test: Multicore flpr_sleep_test on"
        - "flpr_sleep_test: Multicore flpr_sleep_test on"
        - "flpr_sleep_test: Run 0"
        - "flpr_sleep_test: Run 1"

  benchmarks.multicore.flpr_sleep_test.lm20_wait:
    platform_allow:
      - nrf54lm20dk/nrf54lm20a/cpuapp
    tags: ppk_power_measure
    extra_args:
      - flpr_sleep_test_CONF_FILE=prj_silent.conf
      - remote_flpr_CONF_FILE=prj_silent.conf
      - flpr_sleep_test_CONFIG_TEST_SLEEP_DURATION_MS=300
      - remote_flpr_CONFIG_TEST_SLEEP_DURATION_MS=300
    harness: pytest
    harness_config:
      fixture: ppk_power_measure
      pytest_root:
        - "${CUSTOM_ROOT_TEST_DIR}/test_measure_power_consumption.py::test_measure_and_data_dump_ppr_and_s2ram"

  benchmarks.multicore.flpr_sleep_test.lm20_sleep:
    platform_allow:
      - nrf54lm20dk/nrf54lm20a/cpuapp
    tags: ppk_power_measure
    extra_args:
      - flpr_sleep_test_CONF_FILE=prj_silent.conf
      - remote_flpr_CONF_FILE=prj_silent.conf
      - flpr_sleep_test_CONFIG_TEST_SLEEP_DURATION_MS=500
      - remote_flpr_CONFIG_TEST_SLEEP_DURATION_MS=500
    harness: pytest
    harness_config:
      fixture: ppk_power_measure
      pytest_root:
        - "${CUSTOM_ROOT_TEST_DIR}/test_measure_power_consumption.py::test_measure_and_data_dump_ppr_and_s2ram"

  benchmarks.multicore.flpr_sleep_test.lm20_deep_sleep:
    platform_allow:
      - nrf54lm20dk/nrf54lm20a/cpuapp
    tags: ppk_power_measure
    extra_args:
      - flpr_sleep_test_CONF_FILE=prj_silent.conf
      - remote_flpr_CONF_FILE=prj_silent.conf
      - flpr_sleep_test_CONFIG_TEST_SLEEP_DURATION_MS=800
      - remote_flpr_CONFIG_TEST_SLEEP_DURATION_MS=800
    harness: pytest
    harness_config:
      fixture: ppk_power_measure
      pytest_root:
        - "${CUSTOM_ROOT_TEST_DIR}/test_measure_power_consumption.py::test_measure_and_data_dump_ppr_and_s2ram"

  benchmarks.multicore.flpr_sleep_test.lm20_hibernate:
    platform_allow:
      - nrf54lm20dk/nrf54lm20a/cpuapp
    tags: ppk_power_measure
    extra_args:
      - flpr_sleep_test_CONF_FILE=prj_silent.conf
      - remote_flpr_CONF_FILE=prj_silent.conf
      - flpr_sleep_test_CONFIG_TEST_SLEEP_DURATION_MS=1200
      - remote_flpr_CONFIG_TEST_SLEEP_DURATION_MS=1200
    harness: pytest
    harness_config:
      fixture: ppk_power_measure
      pytest_root:
        - "${CUSTOM_ROOT_TEST_DIR}/test_measure_power_consumption.py::test_measure_and_data_dump_ppr_and_s2ram"

  benchmarks.multicore.flpr_sleep_test.lm20_baseline:
    platform_allow:
      - nrf54lm20dk/nrf54lm20a/cpuapp
    tags: ppk_power_measure
    extra_args:
      - flpr_sleep_test_CONF_FILE=prj_silent.conf
      - remote_flpr_CONF_FILE=prj_silent.conf
      - flpr_sleep_test_CONFIG_TEST_BASELINE_SLEEP=y
      - remote_flpr_CONFIG_TEST_BASELINE_SLEEP=y
    harness: pytest
    harness_config:
      fixture: ppk_power_measure
      pytest_root:
        - "${CUSTOM_ROOT_TEST_DIR}/test_measure_power_consumption.py::test_measure_and_data_dump_ppr_and_s2ram"

  # -------------------------------------------------------------------------
  # nRF54L15 tests
  # -------------------------------------------------------------------------

  benchmarks.multicore.flpr_sleep_test.l15_no_sleep:
    platform_allow:
      - nrf54l15dk/nrf54l15/cpuapp
    integration_platforms:
      - nrf54l15dk/nrf54l15/cpuapp
    harness: console
    harness_config:
      type: multi_line
      ordered: true
      regex:
        - "flpr_sleep_test: Multicore flpr_sleep_test on"
        - "flpr_sleep_test: Multicore flpr_sleep_test on"
        - "flpr_sleep_test: Run 0"
        - "flpr_sleep_test: Run 1"

  benchmarks.multicore.flpr_sleep_test.l15_wait:
    platform_allow:
      - nrf54l15dk/nrf54l15/cpuapp
    tags: ppk_power_measure
    extra_args:
      - flpr_sleep_test_CONF_FILE=prj_silent.conf
      - remote_flpr_CONF_FILE=prj_silent.conf
      - flpr_sleep_test_CONFIG_TEST_SLEEP_DURATION_MS=300
      - remote_flpr_CONFIG_TEST_SLEEP_DURATION_MS=300
    harness: pytest
    harness_config:
      fixture: ppk_power_measure
      pytest_root:
        - "${CUSTOM_ROOT_TEST_DIR}/test_measure_power_consumption.py::test_measure_and_data_dump_ppr_and_s2ram"

  benchmarks.multicore.flpr_sleep_test.l15_sleep:
    platform_allow:
      - nrf54l15dk/nrf54l15/cpuapp
    tags: ppk_power_measure
    extra_args:
      - flpr_sleep_test_CONF_FILE=prj_silent.conf
      - remote_flpr_CONF_FILE=prj_silent.conf
      - flpr_sleep_test_CONFIG_TEST_SLEEP_DURATION_MS=500
      - remote_flpr_CONFIG_TEST_SLEEP_DURATION_MS=500
    harness: pytest
    harness_config:
      fixture: ppk_power_measure
      pytest_root:
        - "${CUSTOM_ROOT_TEST_DIR}/test_measure_power_consumption.py::test_measure_and_data_dump_ppr_and_s2ram"

  benchmarks.multicore.flpr_sleep_test.l15_deep_sleep:
    platform_allow:
      - nrf54l15dk/nrf54l15/cpuapp
    tags: ppk_power_measure
    extra_args:
      - flpr_sleep_test_CONF_FILE=prj_silent.conf
      - remote_flpr_CONF_FILE=prj_silent.conf
      - flpr_sleep_test_CONFIG_TEST_SLEEP_DURATION_MS=800
      - remote_flpr_CONFIG_TEST_SLEEP_DURATION_MS=800
    harness: pytest
    harness_config:
      fixture: ppk_power_measure
      pytest_root:
        - "${CUSTOM_ROOT_TEST_DIR}/test_measure_power_consumption.py::test_measure_and_data_dump_ppr_and_s2ram"

  benchmarks.multicore.flpr_sleep_test.l15_hibernate:
    platform_allow:
      - nrf54l15dk/nrf54l15/cpuapp
    tags: ppk_power_measure
    extra_args:
      - flpr_sleep_test_CONF_FILE=prj_silent.conf
      - remote_flpr_CONF_FILE=prj_silent.conf
      - flpr_sleep_test_CONFIG_TEST_SLEEP_DURATION_MS=1200
      - remote_flpr_CONFIG_TEST_SLEEP_DURATION_MS=1200
    harness: pytest
    harness_config:
      fixture: ppk_power_measure
      pytest_root:
        - "${CUSTOM_ROOT_TEST_DIR}/test_measure_power_consumption.py::test_measure_and_data_dump_ppr_and_s2ram"

  benchmarks.multicore.flpr_sleep_test.l15_baseline:
    platform_allow:
      - nrf54l15dk/nrf54l15/cpuapp
    tags: ppk_power_measure
    extra_args:
      - flpr_sleep_test_CONF_FILE=prj_silent.conf
      - remote_flpr_CONF_FILE=prj_silent.conf
      - flpr_sleep_test_CONFIG_TEST_BASELINE_SLEEP=y
      - remote_flpr_CONFIG_TEST_BASELINE_SLEEP=y
    harness: pytest
    harness_config:
      fixture: ppk_power_measure
      pytest_root:
        - "${CUSTOM_ROOT_TEST_DIR}/test_measure_power_consumption.py::test_measure_and_data_dump_ppr_and_s2ram"
```
